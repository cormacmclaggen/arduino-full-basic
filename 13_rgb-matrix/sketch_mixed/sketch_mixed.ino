#include <FrequencyTimer2.h>

/* ===============================
   BITMAP DEFINITIONS (8x8)
   =============================== */

#define SPACE { \
{0,0,0,0,0,0,0,0}, \
{0,0,0,0,0,0,0,0}, \
{0,0,0,0,0,0,0,0}, \
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{0,0,0,0,0,0,0,0}, \
}

#define H { \
{0,1,0,0,0,0,1,0}, \
{0,1,0,0,0,0,1,0}, \
{0,1,0,0,0,0,1,0}, \
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{0,1,0,0,0,0,1,0}, \
}

#define I { \
{0,0,1,1,1,0,0,0}, \
{0,0,0,1,0,0,0,0}, \
{0,0,0,1,0,0,0,0}, \
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{0,0,1,1,1,0,0,0}, \
}

#define Q { \
{0,0,0,0,0,0,1,0}, \
{0,0,0,0,1,1,1,0}, \
{0,0,0,0,1,1,1,0}, \
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{0,1,1,0,0,0,0,0}  \
}

#define SMILE { \
{0,0,0,0,0,0,0,0}, \
{0,0,1,0,0,0,1,0}, \
{0,1,0,1,0,1,0,1}, \
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{0,0,0,1,1,1,0,0}, \
}

/* ===== STRAIGHT ARROWS ===== */

#define ARROW_R { \
{0,0,0,0,1,0,0,0}, \
{0,0,0,0,1,1,0,0}, \
{0,0,0,0,1,1,1,0}, \
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{0,0,0,0,1,0,0,0}, \
}

#define ARROW_L { \
{0,0,0,1,0,0,0,0}, \
{0,0,1,1,0,0,0,0}, \
{0,1,1,1,0,0,0,0}, \
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{0,0,0,0,0,0,0,0}, \
}

#define ARROW_U { \
{0,0,0,1,0,0,0,0}, \
{0,0,1,1,1,0,0,0}, \
{0,1,0,1,0,1,0,0}, \
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{0,0,0,1,0,0,0,0}, \
}

#define ARROW_D { \
{0,0,0,1,0,0,0,0}, \
{0,0,0,1,0,0,0,0}, \
{0,0,0,1,0,0,0,0}, \
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{0,0,0,1,0,0,0,0}, \
}

/* ===== DIAGONAL ARROWS ===== */

#define ARROW_DR { \
{1,0,0,0,0,0,0,1}, \
{0,1,0,0,0,0,0,1}, \
{0,0,1,0,0,0,0,1}, \
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{1,1,1,1,1,1,1,1}, \
}

#define ARROW_UL { \
{1,1,1,1,1,1,1,1}, \
{1,1,0,0,0,0,0,0}, \
{1,0,1,0,0,0,0,0}, \
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{1,0,0,0,0,0,0,1},  \
}

#define ARROW_UR { \
{1,1,1,1,1,1,1,1}, \
{0,0,0,0,0,0,1,1}, \
{0,0,0,0,0,1,0,1}, \
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{1,0,0,0,0,0,0,1}, \
}

#define ARROW_DL { \
{1,0,0,0,0,0,0,1}, \
{1,0,0,0,0,0,1,0}, \
{1,0,0,0,0,1,0,0}, \
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{1,1,1,1,1,1,1,1}, \
}

/* ===============================
   GLOBAL VARIABLES
   =============================== */

byte col = 0;
byte leds[8][8];

int pins[17] = {-1,5,4,3,2,14,15,16,17,13,12,11,10,9,8,7,6};

int rows[8] = {
  pins[9], pins[14], pins[8], pins[12],
  pins[1], pins[7], pins[2], pins[5]
};

int cols[8] = {
  pins[13], pins[3], pins[4], pins[10],
  pins[6], pins[11], pins[15], pins[16]
};

const int numPatterns = 13;

byte patterns[numPatterns][8][8] = {
  H, I, Q, SMILE, SPACE,
  ARROW_R, ARROW_L, ARROW_U, ARROW_D,
  ARROW_UR, ARROW_DR, ARROW_UL, ARROW_DL
};

int pattern = 0;

/* ===============================
   SETUP
   =============================== */

void setup() {
  for (int i = 1; i <= 16; i++) pinMode(pins[i], OUTPUT);

  for (int i = 0; i < 8; i++) {
    digitalWrite(cols[i], HIGH);
    digitalWrite(rows[i], HIGH);
  }

  clearLeds();

  FrequencyTimer2::disable();
  FrequencyTimer2::setPeriod(3000);
  FrequencyTimer2::setOnOverflow(display);
  FrequencyTimer2::enable();
}

/* ===============================
   LOOP
   =============================== */

void loop() {
  pattern = (pattern + 1) % numPatterns;
  clearLeds();
  slidePattern(pattern, 300);
}

/* ===============================
   FUNCTIONS
   =============================== */

void clearLeds() {
  for (int i = 0; i < 8; i++)
    for (int j = 0; j < 8; j++)
      leds[i][j] = 0;
}

void setPattern(int p) {
  for (int i = 0; i < 8; i++)
    for (int j = 0; j < 8; j++)
      leds[i][j] = patterns[p][i][j];
}

void slidePattern(int p, int del) {
  setPattern(p);

  for (int t = 0; t < 8; t++) {
    for (int i = 0; i < 7; i++)
      for (int j = 0; j < 8; j++)
        leds[j][i] = leds[j][i + 1];

    for (int j = 0; j < 8; j++)
      leds[j][7] = patterns[p][j][t];

    delay(del);
  }
}

void display() {
  // Tắt tất cả COL
  for (int c = 0; c < 8; c++)
    digitalWrite(cols[c], HIGH);

  // Tắt tất cả ROW
  for (int r = 0; r < 8; r++)
    digitalWrite(rows[r], LOW);

  // Sang cột tiếp theo
  col = (col + 1) % 8;

  // Set ROW theo dữ liệu
  for (int r = 0; r < 8; r++) {
    if (leds[col][7 - r])
      digitalWrite(rows[r], HIGH);
  }

  // Bật COL hiện tại
  digitalWrite(cols[col], LOW);
}
